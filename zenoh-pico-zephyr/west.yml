## zenoh-pico-zephyr/west.yml
```yaml
manifest:

  self:
    path: zenoh-zephyr

  remotes:
    - name: zephyrproject-rtos
      url-base: https://github.com/zephyrproject-rtos

  projects:
    - name: zephyr
      remote: zephyrproject-rtos
      revision: v3.3.0
      path: zephyr
      import:
        name-allowlist:
          - cmsis
          - hal_stm32
          - hal_nordic
          - mbedtls
```
